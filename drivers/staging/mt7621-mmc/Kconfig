## drivers/staging/mt7621-mmc/Kconfig
```kconfig
config MTK_MMC
    tristate "MTK SD/MMC"
    depends on !MTD_NAND_RALINK && MMC
    help
      Obsługa kontrolera SD/MMC MediaTek MT7621.

config MTK_MMC_CD_POLL
    bool "Card Detect with Polling"
    depends on MTK_MMC

config MTK_MMC_EMMC_8BIT
    bool "eMMC 8-bit support"
    depends on MTK_MMC
```
